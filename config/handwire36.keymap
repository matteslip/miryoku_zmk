// Copyright 2024 Manna Harbour
// https://github.com/manna-harbour/miryoku
//
// 36-key handwire -- Miryoku with Minidox-style mapping

#include "../miryoku/custom_config.h"
#include "../miryoku/mapping/36/minidox.h"
#include "../miryoku/miryoku.dtsi"
