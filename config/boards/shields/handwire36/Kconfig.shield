## config/boards/shields/handwire36/Kconfig.shield
```kconfig
# Copyright 2024 Manna Harbour
# https://github.com/manna-harbour/miryoku
#
# Kconfig shield definition for handwire36 split

config SHIELD_HANDWIRE36_LEFT
    def_bool $(shields_list_contains,handwire36_left)

config SHIELD_HANDWIRE36_RIGHT
    def_bool $(shields_list_contains,handwire36_right)

if SHIELD_HANDWIRE36_LEFT

config ZMK_SPLIT_ROLE_CENTRAL
    bool
    default y

endif # SHIELD_HANDWIRE36_LEFT

if SHIELD_HANDWIRE36_RIGHT

config ZMK_SPLIT_ROLE_CENTRAL
    bool
    default y

endif # SHIELD_HANDWIRE36_RIGHT
```
