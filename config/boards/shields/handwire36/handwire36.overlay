/*
 * Copyright 2024 Manna Harbour
 * https://github.com/manna-harbour/miryoku
 *
 * Handwire 36-key (3x5+3) direct-pin shield for nice!nano
 *
 * ⚠️  REPLACE the GPIO pin numbers below with YOUR actual wiring.
 *     Each half has its own nice!nano; pin numbers can be the same
 *     on both sides since they refer to separate microcontrollers.
 *
 * This file is used for BOTH left and right builds. The kscan GPIOs
 * and matrix transform are selected at compile time via
 * CONFIG_ZMK_SPLIT_ROLE_CENTRAL.
 *
 * Build: board=nice_nano_v2  shield=handwire36_left   (left / central)
 *        board=nice_nano_v2  shield=handwire36_right  (right / peripheral)
 */

#include <dt-bindings/zmk/matrix_transform.h>

/ {
    kscan0: kscan {
        compatible = "zmk,kscan_gpio_direct";
        input-gpios =
/* ── LEFT half (CENTRAL) ─────────────────────────────────────────── */
#if CONFIG_ZMK_SPLIT_ROLE_CENTRAL
            /* K00  K01  K02  K03  K04  ← top row */
            <&gpio0 13 (GPIO_ACTIVE_LOW | GPIO_PULL_UP)>,   /* K00 */
            <&gpio0 15 (GPIO_ACTIVE_LOW | GPIO_PULL_UP)>,   /* K01 */
            <&gpio0 17 (GPIO_ACTIVE_LOW | GPIO_PULL_UP)>,   /* K02 */
            <&gpio0 20 (GPIO_ACTIVE_LOW | GPIO_PULL_UP)>,   /* K03 */
            <&gpio0 22 (GPIO_ACTIVE_LOW | GPIO_PULL_UP)>,   /* K04 */
            /* K10  K11  K12  K13  K14  ← middle row */
            <&gpio0 12 (GPIO_ACTIVE_LOW | GPIO_PULL_UP)>,   /* K10 */
            <&gpio0 14 (GPIO_ACTIVE_LOW | GPIO_PULL_UP)>,   /* K11 */
            <&gpio0 16 (GPIO_ACTIVE_LOW | GPIO_PULL_UP)>,   /* K12 */
            <&gpio0 19 (GPIO_ACTIVE_LOW | GPIO_PULL_UP)>,   /* K13 */
            <&gpio0 21 (GPIO_ACTIVE_LOW | GPIO_PULL_UP)>,   /* K14 */
            /* K20  K21  K22  K23  K24  ← bottom row */
            <&gpio0 11 (GPIO_ACTIVE_LOW | GPIO_PULL_UP)>,   /* K20 */
            <&gpio0 10 (GPIO_ACTIVE_LOW | GPIO_PULL_UP)>,   /* K21 */
            <&gpio0 09 (GPIO_ACTIVE_LOW | GPIO_PULL_UP)>,   /* K22 */
            <&gpio0 08 (GPIO_ACTIVE_LOW | GPIO_PULL_UP)>,   /* K23 */
            <&gpio0 07 (GPIO_ACTIVE_LOW | GPIO_PULL_UP)>,   /* K24 */
            /* K32  K33  K34              ← thumbs */
            <&gpio0 06 (GPIO_ACTIVE_LOW | GPIO_PULL_UP)>,   /* K32 */
            <&gpio0 05 (GPIO_ACTIVE_LOW | GPIO_PULL_UP)>,   /* K33 */
            <&gpio0 04 (GPIO_ACTIVE_LOW | GPIO_PULL_UP)>,   /* K34 */
/* ── RIGHT half (PERIPHERAL) ──────────────────────────────────────── */
#else
            /* K05  K06  K07  K08  K09  ← top row */
            <&gpio0 11 (GPIO_ACTIVE_LOW | GPIO_PULL_UP)>,   /* K05 — P0.11 */
            <&gpio0 12 (GPIO_ACTIVE_LOW | GPIO_PULL_UP)>,   /* K06 — P0.12 */
            <&gpio0 9 (GPIO_ACTIVE_LOW | GPIO_PULL_UP)>,    /* K07 — P0.09 */
            <&gpio1 13 (GPIO_ACTIVE_LOW | GPIO_PULL_UP)>,   /* K08 — P1.13 */
            <&gpio1 7 (GPIO_ACTIVE_LOW | GPIO_PULL_UP)>,    /* K09 — P1.07 */
            /* K15  K16  K17  K18  K19  ← middle row */
            <&gpio1 0 (GPIO_ACTIVE_LOW | GPIO_PULL_UP)>,    /* K15 — P1.00 */
            <&gpio1 6 (GPIO_ACTIVE_LOW | GPIO_PULL_UP)>,    /* K16 — P1.06 */
            <&gpio0 10 (GPIO_ACTIVE_LOW | GPIO_PULL_UP)>,   /* K17 — P0.10 */
            <&gpio1 15 (GPIO_ACTIVE_LOW | GPIO_PULL_UP)>,   /* K18 — P1.15 */
            <&gpio1 2 (GPIO_ACTIVE_LOW | GPIO_PULL_UP)>,    /* K19 — P1.02 */
            /* K25  K26  K27  K28  K29  ← bottom row */
            <&gpio0 24 (GPIO_ACTIVE_LOW | GPIO_PULL_UP)>,   /* K25 — P0.24 */
            <&gpio1 1 (GPIO_ACTIVE_LOW | GPIO_PULL_UP)>,    /* K26 — P1.01 */
            <&gpio1 11 (GPIO_ACTIVE_LOW | GPIO_PULL_UP)>,   /* K27 — P1.11 */
            <&gpio0 2 (GPIO_ACTIVE_LOW | GPIO_PULL_UP)>,    /* K28 — P0.02 */
            <&gpio0 29 (GPIO_ACTIVE_LOW | GPIO_PULL_UP)>,   /* K29 — ⚠️  PLACEHOLDER P0.29 (was duplicate of K09 — проверь свой распиновку!) */
            /* K35  K36  K37              ← thumbs */
            <&gpio0 22 (GPIO_ACTIVE_LOW | GPIO_PULL_UP)>,   /* K35 — P0.22 */
            <&gpio0 20 (GPIO_ACTIVE_LOW | GPIO_PULL_UP)>,   /* K36 — P0.20 */
            <&gpio0 17 (GPIO_ACTIVE_LOW | GPIO_PULL_UP)>,   /* K37 — P0.17 */
#endif
            ;
    };
};

/ {
    chosen {
        zmk,kscan = &kscan0;
        zmk,matrix-transform = &default_transform;
    };

/* ── LEFT transform ──────────────────────────────────────────────── */
#if CONFIG_ZMK_SPLIT_ROLE_CENTRAL
    default_transform: keymap_transform_0 {
        compatible = "zmk,matrix-transform";
        columns = <10>;
        rows = <4>;
        map = <
            RC(0,0) RC(0,1) RC(0,2) RC(0,3) RC(0,4)
            RC(1,0) RC(1,1) RC(1,2) RC(1,3) RC(1,4)
            RC(2,0) RC(2,1) RC(2,2) RC(2,3) RC(2,4)
                     RC(3,2) RC(3,3) RC(3,4)
        >;
    };
/* ── RIGHT transform ─────────────────────────────────────────────── */
#else
    default_transform: keymap_transform_0 {
        compatible = "zmk,matrix-transform";
        columns = <10>;
        rows = <4>;
        map = <
            RC(0,5) RC(0,6) RC(0,7) RC(0,8) RC(0,9)
            RC(1,5) RC(1,6) RC(1,7) RC(1,8) RC(1,9)
            RC(2,5) RC(2,6) RC(2,7) RC(2,8) RC(2,9)
                     RC(3,5) RC(3,6) RC(3,7)
        >;
    };
#endif
};
